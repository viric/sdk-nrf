## CMakeLists.txt
```
# SPDX-License-Identifier: Apache-2.0

cmake_minimum_required(VERSION 3.20.0)
find_package(Zephyr REQUIRED HINTS $ENV{ZEPHYR_BASE})
project(peripheral)

target_sources(app PRIVATE
  src/main.c
  src/temp.c
  src/power.c
)
```

## prj.conf
```kconfig
# Increased stack due to settings API usage
CONFIG_SYSTEM_WORKQUEUE_STACK_SIZE=2048

CONFIG_BT=y
CONFIG_BT_DEBUG_LOG=y
CONFIG_BT_SMP=y
CONFIG_BT_SIGNING=y
CONFIG_BT_PERIPHERAL=y
CONFIG_BT_DIS=y
CONFIG_BT_ATT_PREPARE_COUNT=5
CONFIG_BT_PRIVACY=y
CONFIG_BT_DEVICE_NAME="Power meter"
CONFIG_BT_DEVICE_APPEARANCE=833
CONFIG_BT_DEVICE_NAME_DYNAMIC=n
CONFIG_BT_DEVICE_NAME_MAX=65

CONFIG_BT_BONDABLE=y

CONFIG_BT_KEYS_OVERWRITE_OLDEST=y
CONFIG_BT_SETTINGS=y
CONFIG_FLASH=y
CONFIG_FLASH_PAGE_LAYOUT=y
CONFIG_FLASH_MAP=y
CONFIG_NVS=y
CONFIG_SETTINGS=y

CONFIG_SENSOR=y
CONFIG_TEMP_NRF5=y
CONFIG_ADC=y
CONFIG_ADC_NRFX_SAADC=y
```

## boards/bbc_microbit_v2.overlay
```dts
/ {
    zephyr,user {
        io-channels = <&adc 0>;
    };
};

&adc {
    #address-cells = <1>;
    #size-cells = <0>;
    status = "okay";

    channel@0 {
        reg = <0>;
        /* Internal Ref = 0.6V. To catch up to 3.3V, we need gain 1/6 */
        zephyr,gain = "ADC_GAIN_1_6";
        zephyr,reference = "ADC_REF_INTERNAL";
        zephyr,acquisition-time = <ADC_ACQ_TIME_DEFAULT>;
        zephyr,input-positive = <NRF_SAADC_AIN0>; /* P0.03 */
        zephyr,resolution = <10>;
    };
};
```

## src/main.c
```c
/* main.c - Application main entry point */

/*
 * Copyright (c) 2015-2016 Intel Corporation
 *
 * SPDX-License-Identifier: Apache-2.0
 */

#include <zephyr/types.h>
#include <stddef.h>
#include <string.h>
#include <errno.h>
#include <zephyr/sys/printk.h>
#include <zephyr/sys/byteorder.h>
#include <zephyr/zephyr.h>

#include <zephyr/settings/settings.h>

#include <zephyr/bluetooth/bluetooth.h>
#include <zephyr/bluetooth/hci.h>
#include <zephyr/bluetooth/conn.h>
#include <zephyr/bluetooth/uuid.h>
#include <zephyr/bluetooth/gatt.h>

#include "main.h"

static const struct bt_data ad[] = {
	BT_DATA_BYTES(BT_DATA_FLAGS, (BT_LE_AD_GENERAL | BT_LE_AD_NO_BREDR)),
	BT_DATA_BYTES(BT_DATA_UUID16_ALL,
		      BT_UUID_16_ENCODE(BT_UUID_ENVSENS_TEMPERATURE_VAL),
		      BT_UUID_16_ENCODE(BT_UUID_GATT_POWER_VAL)),
};

static void connected(struct bt_conn *conn, uint8_t err)
{
	if (err) {
		printk("Connection failed (err 0x%02x)\n", err);
	} else {
		printk("Connected\n");
	}
}

static void disconnected(struct bt_conn *conn, uint8_t reason)
{
	printk("Disconnected (reason 0x%02x)\n", reason);
}

BT_CONN_CB_DEFINE(conn_callbacks) = {
	.connected = connected,
	.disconnected = disconnected,
};

static void bt_ready(void)
{
	int err;

	printk("Bluetooth initialized\n");

	if (IS_ENABLED(CONFIG_SETTINGS)) {
		settings_load();
	}

	err = bt_le_adv_start(BT_LE_ADV_CONN_NAME, ad, ARRAY_SIZE(ad), NULL, 0);
	if (err) {
		printk("Advertising failed to start (err %d)\n", err);
		return;
	}

	printk("Advertising successfully started\n");
}

static void auth_passkey_display(struct bt_conn *conn, unsigned int passkey)
{
	char addr[BT_ADDR_LE_STR_LEN];

	bt_addr_le_to_str(bt_conn_get_dst(conn), addr, sizeof(addr));

	printk("Passkey for %s: %06u\n", addr, passkey);
}

static void auth_cancel(struct bt_conn *conn)
{
	char addr[BT_ADDR_LE_STR_LEN];

	bt_addr_le_to_str(bt_conn_get_dst(conn), addr, sizeof(addr));

	printk("Pairing cancelled: %s\n", addr);
}

static struct bt_conn_auth_cb auth_cb_display = {
	.passkey_display = auth_passkey_display,
	.passkey_entry = NULL,
	.cancel = auth_cancel,
};

void main(void)
{
	int err;

	err = bt_enable(NULL);
	if (err) {
		printk("Bluetooth init failed (err %d)\n", err);
		return;
	}

	bt_ready();

	bt_conn_auth_cb_register(&auth_cb_display);

	/* Implement notification. At the moment there is no suitable way
	 * of starting delayed work so we do it here
	 */
	while (1) {
		k_sleep(K_SECONDS(1));
	}
}
```

## src/main.h
```c
#define BT_UUID_ENVSENS BT_UUID_DECLARE_16(0x181A)

#define BT_UUID_ENVSENS_TEMPERATURE_VAL 0x2A6E
#define BT_UUID_ENVSENS_TEMPERATURE BT_UUID_DECLARE_16(BT_UUID_ENVSENS_TEMPERATURE_VAL)

#define BT_UUID_GATT_POWER_VAL 0x2b05
#define BT_UUID_GATT_POWER BT_UUID_DECLARE_16(BT_UUID_GATT_POWER_VAL)
```

## src/power.c
```c
/** @file
 *  @brief GATT Battery Service
 */

/*
 * Copyright (c) 2018 Nordic Semiconductor ASA
 * Copyright (c) 2016 Intel Corporation
 *
 * SPDX-License-Identifier: Apache-2.0
 */

#include <errno.h>
#include <zephyr/init.h>
#include <zephyr/sys/__assert.h>
#include <stdbool.h>
#include <zephyr/types.h>
#include <math.h>

#include <zephyr/bluetooth/bluetooth.h>
#include <zephyr/bluetooth/conn.h>
#include <zephyr/bluetooth/gatt.h>
#include <zephyr/bluetooth/uuid.h>
#include <zephyr/drivers/adc.h>

#define LOG_LEVEL CONFIG_BT_BAS_LOG_LEVEL
#include <zephyr/logging/log.h>

#include "main.h"

LOG_MODULE_REGISTER(voltage);

int32_t bt_voltage_get_power(void);

static const struct adc_dt_spec power_adc_spec =
    ADC_DT_SPEC_GET(DT_PATH(zephyr_user));

static int properly_setup = 0;

static int32_t mean = 0;

static ssize_t read_power(struct bt_conn *conn,
			       const struct bt_gatt_attr *attr, void *buf,
			       uint16_t len, uint16_t offset)
{
	int32_t lvl = bt_voltage_get_power();

	return bt_gatt_attr_read(conn, attr, buf, len, offset, &lvl,
				 sizeof(lvl));
}

BT_GATT_SERVICE_DEFINE(voltage,
	BT_GATT_PRIMARY_SERVICE(BT_UUID_GATT),
	BT_GATT_CHARACTERISTIC(BT_UUID_GATT_POWER,
			       BT_GATT_CHRC_READ/* | BT_GATT_CHRC_NOTIFY*/,
			       BT_GATT_PERM_READ, read_power, NULL,
			       NULL),
);

static int voltage_init(const struct device *dev)
{
    int res;

    res = adc_channel_setup_dt(&power_adc_spec);

    if (res != 0)
    {
        LOG_ERR("ADC device not found");
        return -1;
    }
    LOG_INF("ADC device initialised");

    if (res != 0)
    {
        LOG_ERR("ADC channel setup failed");
        return -1;
    }

    properly_setup = 1;

	return 0;
}

int32_t bt_voltage_get_power(void)
{
    // Scan 100 samples per 20ms cycle. 20 cycles, 2000 samples
    // 0.2ms per sample, 200us.
#define NSAMPLES 2000
    static int16_t buf[NSAMPLES];
    const struct adc_sequence_options options = {
        .interval_us = 200,
        .extra_samplings = NSAMPLES-1,
    };
    struct adc_sequence sequence = {
        .options = &options,
        .buffer = buf,
        .channels = 1,
        .buffer_size = sizeof(buf),
    };
    int err;

    if (!properly_setup)
    {
        return -1;
    }

    adc_sequence_init_dt(&power_adc_spec, &sequence);

    err = adc_read(power_adc_spec.dev, &sequence);
    if (err < 0)
    {
        LOG_ERR("ADC reading failed");
        return -1;
    }
    LOG_INF("ADC raw[0] read: %hd", buf[0]);
    LOG_INF("ADC raw[NSAMPLES-1] read: %hd", buf[NSAMPLES-1]);

    const float factor = 0.6 * 6 / 1024 / 220 * 2000 * 230;

    int32_t meansum = 0;
    int32_t sum = 0;

    for(int i=0; i < NSAMPLES; ++i)
    {
        meansum += buf[i];
        int32_t filtered = buf[i] - mean;
        sum += filtered * filtered;
    }

    mean = meansum / NSAMPLES;
    int32_t power = sqrtf((float)sum / NSAMPLES) * factor;

    LOG_INF("Voltage raw mean: %d", mean);
    LOG_INF("ADC power calculation: %d", power);

    return power;
}

SYS_INIT(voltage_init, APPLICATION, CONFIG_APPLICATION_INIT_PRIORITY);
```
